## src/mainboard/dell/inspiron_3847/Kconfig
```kconfig
if BOARD_DELL_INSPIRON_3847

config BOARD_SPECIFIC_OPTIONS
	def_bool y
	select BOARD_ROMSIZE_KB_8192
	select HAVE_ACPI_RESUME
	select HAVE_ACPI_TABLES
	select MAINBOARD_HAS_LIBGFXINIT # FIXME: check this
	select NORTHBRIDGE_INTEL_HASWELL
	select SERIRQ_CONTINUOUS_MODE
	select SOUTHBRIDGE_INTEL_LYNXPOINT

config MAINBOARD_DIR
	string
	default "dell/inspiron_3847"

config MAINBOARD_PART_NUMBER
	string
	default "Inspiron 3847"

config VGA_BIOS_ID
	string
	default "8086,0412"

config USBDEBUG_HCD_INDEX # FIXME: check this
	int
	default 2
endif
```

## src/mainboard/dell/inspiron_620/Kconfig
```kconfig
if BOARD_DELL_INSPIRON_620

config BOARD_SPECIFIC_OPTIONS
	def_bool y
	select BOARD_ROMSIZE_KB_4096
	select HAVE_ACPI_RESUME
	select HAVE_ACPI_TABLES
	select INTEL_INT15
	select MAINBOARD_HAS_LIBGFXINIT # FIXME: check this
	select NORTHBRIDGE_INTEL_SANDYBRIDGE
	select SERIRQ_CONTINUOUS_MODE
	select SOUTHBRIDGE_INTEL_BD82X6X
	select USE_NATIVE_RAMINIT

config MAINBOARD_DIR
	string
	default "dell/inspiron_620"

config MAINBOARD_PART_NUMBER
	string
	default "Inspiron 620"

config VGA_BIOS_ID
	string
	default "8086,0102"

config DRAM_RESET_GATE_GPIO # FIXME: check this
	int
	default 60

config USBDEBUG_HCD_INDEX # FIXME: check this
	int
	default 2
endif
```
